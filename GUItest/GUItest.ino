#define ENABLE_GxEPD2_GFX 1
#include <GxEPD2_BW.h>

//fonts
#include "Fonts/Picopixel.h"
#include "Fonts/FreeMonoBold18pt7b.h"

//bitmaps
static const unsigned char PROGMEM base[] = {0xff,0xe7,0xff,0x1f,0xfc,0x7f,0xf1,0xff,0xc7,0xff,0x3f,0xf8,0xff,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0x00,0x00};

#define GxEPD2_DISPLAY_CLASS GxEPD2_BW
#define MAX_DISPLAY_BUFFER_SIZE 131072ul
#define MAX_HEIGHT(EPD) (EPD::HEIGHT <= MAX_DISPLAY_BUFFER_SIZE / (EPD::WIDTH / 8) ? EPD::HEIGHT : MAX_DISPLAY_BUFFER_SIZE / (EPD::WIDTH / 8))
#define GxEPD2_DRIVER_CLASS GxEPD2_213_GDEY0213B74 // GDEY0213B74 122x250, SSD1680, (FPC-A002 20.04.08)
GxEPD2_DISPLAY_CLASS<GxEPD2_DRIVER_CLASS, MAX_HEIGHT(GxEPD2_DRIVER_CLASS)> display(GxEPD2_DRIVER_CLASS(/*CS=*/ 9, /*DC=*/ 8, /*RST=*/ 12, /*BUSY=*/ 13)); // Waveshare Pico-ePaper-2.9
SPIClassRP2040 SPIn(spi1, -1, 13, 10, 11);

#include "SparkFun_AS7265X.h" //http://librarymanager/All#SparkFun_AS7265X
AS7265X sensor;

#include <Wire.h>

// Wavelengths
const char* wavelengthNames[] = {
  "410nm (A) - Violet  ", "435nm (B) - Indigo  ", "460nm (C) - Blue    ",
  "485nm (D) - Cyan    ", "510nm (E) - Green   ", "535nm (F) - Lime    ",
  "560nm (G) - Yellow  ", "585nm (H) - Orange  ", "610nm (R) - Orange+ ",
  "645nm (I) - Red     ", "680nm (S) - Deep Red", "705nm (J) - Red+    ",
  "730nm (T) - NIR     ", "760nm (U) - NIR     ", "810nm (V) - NIR     ",
  "860nm (W) - NIR     ", "900nm (K) - NIR     ", "940nm (L) - NIR     "
};

// Store the sensor readings in an array
float readings[18];
uint8_t intreadings[18];

// Determine the dominant colour range
String detectColour() {
  int maxIndex = 0;
  float maxVal = readings[0];
  
  // Find the peak wavelength
  for (int i = 1; i < 18; i++) {
    if (readings[i] > maxVal) {
      maxVal = readings[i];
      maxIndex = i;
    }
  }
  
  // Determine colour based on peak wavelength
  if (maxIndex <= 2) return "VIOLET/BLUE";
  else if (maxIndex <= 4) return "CYAN/GREEN";
  else if (maxIndex <= 6) return "YELLOW/LIME";
  else if (maxIndex <= 9) return "ORANGE/RED";
  else if (maxIndex <= 11) return "DEEP RED";
  else return "INFRARED (NOT VISIBLE)";
}

void setup() {
  //serial terminal enable
  Serial.begin(115200);
  Serial.println();
  Serial.println("setup start");
  delay(100);

  //select SPI and initialise display
  Serial.println("display init");
  display.epd2.selectSPI(SPIn, SPISettings(4000000, MSBFIRST, SPI_MODE0));
  display.init(115200, true, 10, false, SPIn, SPISettings(4000000, MSBFIRST, SPI_MODE0));
  //full refresh to begin
  Serial.println("full refresh");
  display.clearScreen();

  sensor.begin();
  sensor.disableIndicator(); 
  Serial.println("setup end");
}

void loop() {
  sensor.takeMeasurementsWithBulb();
  
  readings[0] = sensor.getCalibratedA();  // 410nm
  readings[1] = sensor.getCalibratedB();  // 435nm
  readings[2] = sensor.getCalibratedC();  // 460nm
  readings[3] = sensor.getCalibratedD();  // 485nm
  readings[4] = sensor.getCalibratedE();  // 510nm
  readings[5] = sensor.getCalibratedF();  // 535nm
  readings[6] = sensor.getCalibratedG();  // 560nm
  readings[7] = sensor.getCalibratedH();  // 585nm
  readings[8] = sensor.getCalibratedR();  // 610nm
  readings[9] = sensor.getCalibratedI();  // 645nm
  readings[10] = sensor.getCalibratedS(); // 680nm
  readings[11] = sensor.getCalibratedJ(); // 705nm
  readings[12] = sensor.getCalibratedT(); // 730nm
  readings[13] = sensor.getCalibratedU(); // 760nm
  readings[14] = sensor.getCalibratedV(); // 810nm
  readings[15] = sensor.getCalibratedW(); // 860nm
  readings[16] = sensor.getCalibratedK(); // 900nm
  readings[17] = sensor.getCalibratedL(); // 940nm
  float maxReading = 0;
  for (int i = 0; i < 18; i++) {
    if (readings[i] > maxReading) maxReading = readings[i];
  }
  for (int i = 0; i < 18; i++) {
    intreadings[i] = readings[i] / maxReading * 69;
  }
  drawBars(intreadings);
  display.refresh(false);
  delay(5000);
}

void drawBase()
{
  Serial.println("draw base");
  display.setRotation(1); //sets landscape rotation
  display.setFullWindow(); //sets full refresh mode
  display.firstPage();     //start paged drawing

  do {
    //ALL DRAWING COMMANDS GO INSIDE THE LOOP

    //Set background for the current page
    display.fillScreen(GxEPD_WHITE);

    //Draw Empty bars (Bitmap)
    display.drawBitmap(2, 37, base, 245, 91, GxEPD_BLACK);
    
    //Draw border to check boundaries
    display.drawRect(0, 6, 250, 122, GxEPD_BLACK);

    //Draw Title text (Set font, color, cursor, print)
    display.setFont(&FreeMonoBold18pt7b);
    display.setTextColor(GxEPD_BLACK);
    display.setCursor(0, 27);
    display.print("Ripe");

  } while (display.nextPage()); // Send page buffer & check if more pages

  Serial.println("base done");
}

void drawBars(uint8_t *readings)
{
  Serial.println("draw bars");
  display.setRotation(1); //sets landscape rotation
  display.setPartialWindow(0, 0, display.width(), display.height()); //sets partial refresh window over whole display
  display.firstPage();     //start paged drawing

  do {
    //ALL DRAWING COMMANDS GO INSIDE THE LOOP

    //Set background for the current page
    display.fillScreen(GxEPD_WHITE);

    display.drawBitmap(2, 37, base, 245, 91, GxEPD_BLACK);
    //Draw Filled bars (Rectangles)
    display.fillRect(3, 107, 9, -readings[0], GxEPD_BLACK);
    display.fillRect(16, 107, 9, -readings[1], GxEPD_BLACK);
    display.fillRect(30, 107, 9, -readings[2], GxEPD_BLACK);
    display.fillRect(44, 107, 9, -readings[3], GxEPD_BLACK);
    display.fillRect(58, 107, 9, -readings[4], GxEPD_BLACK);
    display.fillRect(72, 107, 9, -readings[5], GxEPD_BLACK);
    display.fillRect(85, 107, 9, -readings[6], GxEPD_BLACK);
    display.fillRect(99, 107, 9, -readings[7], GxEPD_BLACK);
    display.fillRect(113, 107, 9, -readings[8], GxEPD_BLACK);
    display.fillRect(127, 107, 9, -readings[9], GxEPD_BLACK);
    display.fillRect(140, 107, 10, -readings[10], GxEPD_BLACK);
    display.fillRect(154, 107, 9, -readings[11], GxEPD_BLACK);
    display.fillRect(168, 107, 9, -readings[12], GxEPD_BLACK);
    display.fillRect(182, 107, 9, -readings[13], GxEPD_BLACK);
    display.fillRect(195, 107, 9, -readings[14], GxEPD_BLACK);
    display.fillRect(209, 107, 9, -readings[15], GxEPD_BLACK);
    display.fillRect(223, 107, 9, -readings[16], GxEPD_BLACK);
    display.fillRect(237, 107, 9, -readings[17], GxEPD_BLACK);

    //Draw Title text (Set font, color, cursor, print)
    display.setFont(&FreeMonoBold18pt7b);
    display.setTextColor(GxEPD_BLACK);
    display.setCursor(0, 27);
    display.print("Unripe");

  } while (display.nextPage()); // Send page buffer & check if more pages

  Serial.println("base done");
}